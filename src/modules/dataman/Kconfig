## src/modules/dataman/Kconfig
```kconfig
menuconfig MODULES_DATAMAN
	bool "dataman"
	default n
	---help---
		Enable support for dataman


menuconfig USER_DATAMAN
	bool "dataman running as userspace module"
	default y
	depends on BOARD_PROTECTED && MODULES_DATAMAN
	---help---
		Put dataman in userspace memory


menuconfig DATAMAN_STACK_SIZE
	int "stack size of dataman task"
	default 2000
	depends on MODULES_DATAMAN
	---help---
		Stack size of the dataman task. File systems with deeper call
		chains (e.g. littlefs on SPI flash) need more than the default.

menuconfig DATAMAN_PERSISTENT_STORAGE
	bool "dataman supports persistent storage"
	default y
	depends on MODULES_DATAMAN
	---help---
		Dataman supports reading/writing to persistent storage

menuconfig NUM_MISSION_ITEMS_SUPPORTED
	int "Maximum number of mission items"
	default 500
	---help---
		This limit sizes mission storage constants used by dataman and dataman clients.
		It applies whether mission items are stored on the SD card or in RAM. It should
		be set adequately per board such that if the items are stored in RAM they still
		fit the available memory.
		The runtime parameter to configure the storage option is `SYS_DM_BACKEND`.
```
